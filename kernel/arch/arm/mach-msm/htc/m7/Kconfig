## kernel/arch/arm/mach-msm/htc/m7/Kconfig
```kconfig
config BOARD_HEADER_FILE
	string "HTC board specific header file name"
	default ""

config MACH_M7_UL
	depends on ARCH_APQ8064
	select MACH_HTC
	bool "HTC One"
	help
	  Support for the HTC M7 device.

config MACH_M7C
	bool
	select MACH_HTC

config MACH_M7C_DUG
	depends on ARCH_APQ8064
	select MACH_HTC
	select MACH_M7C
	bool "HTC One Dual SIM (802w / m7cdug)"
	help
	  Support for the HTC One 802w Dual SIM device.

config CABC_DIMMING_SWITCH
	depends on MACH_M7_UL || MACH_M7C_DUG
	bool "Enable panel CABC dimming switch"
	default y
	help
	  Enable CABC dimming switch.

config SRE_CONTROL
	depends on MACH_M7_UL || MACH_M7C_DUG
	bool "Enable panel SRE control"
	default y
	help
	  Enable SRE control.
```
